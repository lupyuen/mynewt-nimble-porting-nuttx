## Kconfig
```kconfig
#
# For a description of the syntax of this configuration file,
# see the file kconfig-language.txt in the NuttX tools repository.
#

menuconfig LIBNPL
	bool "NimBLE Porting Layer"
	default n
	---help---
		Enable build for NimBLE Porting Layer

if LIBNPL

config LIBNPL_DEBUG
	bool "NimBLE Porting Layer debugging"
	default n
	---help---
		Enable debugging for NimBLE Porting Layer

endif # LIBNPL
```
